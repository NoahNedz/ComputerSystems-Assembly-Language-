;** ###################################################################
;**     This code is generated by the Device Initialization Tool.
;**     It is overwritten during code generation.
;**     USER MODIFICATION ARE PRESERVED ONLY INSIDE INTERRUPT SERVICE ROUTINES
;**     OR EXPLICITLY MARKED SECTIONS
;**
;**     Project   : hw6
;**     Processor : MC9S12C32CFU16
;**     Version   : Component 02.001, Driver 01.05, CPU db: 2.87.410
;**     Datasheet : MC9S12C128 Rev 01.23 05/2007
;**     Date/Time : 3/22/2017, 6:44 PM
;**     Abstract  :
;**         This module contains device initialization code 
;**         for selected on-chip peripherals.
;**         To compile Absolute Assembler correctly, this
;**         module should be included at the end of user module.
;**         Position for code should be set before including
;**         using ORG directive.        	
;**     Contents  :
;**         No public methods
;**
;**     Copyright : 1997 - 2010 Freescale Semiconductor, Inc. All Rights Reserved.
;**     
;**     http      : www.freescale.com
;**     mail      : support@freescale.com
;** ###################################################################
; MODULE MCUinit

;                   INCLUDE  MC9S12C32.inc ; I/O map for MC9S12C32CFU16

CGM_DELAY: equ  1023

; User declarations and definitions
;   Code, declarations and definitions here will be preserved during code generation
; End of user declarations and definitions



;** ===================================================================
;**     Method      :  MCU_init_reset (component MC9S12C32_80)
;**
;**     Description :
;**         Device initialization code for after reset initialization.
;** ===================================================================
MCU_init_reset:                        ; Reset vector code

; Initialization of the registers INITRG, INITRM, INITEE is done to protect them to be written accidentally later by the application 
        ; INITRG: REG14=0,REG13=0,REG12=0,REG11=0 
        CLR     INITRG                 ; Set the Registers map position 
        NOP
        ; INITRM: RAM15=0,RAM14=0,RAM13=0,RAM12=0,RAM11=1,RAMHAL=1 
        MOVB    #$09,INITRM            ; Set the RAM map position 
        ; MISC: EXSTR1=1,EXSTR0=1,ROMHM=0,ROMON=1 
        MOVB    #$0D,MISC                                        
        ; PEAR: NOACCE=0,PIPOE=0,NECLK=0,LSTRE=0,RDWE=0 
        CLR     PEAR                                               
        ; Jump to the default entry point
        jmp _Startup



;** ===================================================================
;**     Method      :  MCU_init (component MC9S12C32_80)
;**
;**     Description :
;**         Device initialization code for selected peripherals.
;** ===================================================================
MCU_init:

  ; ### MC9S12C32_80 "Cpu" init code ... 
  ;  System clock initialization 
        ; CLKSEL: PLLSEL=0,PSTP=0,SYSWAI=0,ROAWAI=0,PLLWAI=0,CWAI=0,RTIWAI=0,COPWAI=0 
        CLR     CLKSEL                 ; Select clock source from XTAL and set bits in CLKSEL reg. 
        ; PLLCTL: CME=1,PLLON=0,AUTO=1,ACQ=1,PRE=0,PCE=0,SCME=1 
        MOVB    #$B1,PLLCTL            ; Disable the PLL 
  ; Common initialization of the CPU registers 
        ; CRGINT: LOCKIE=0,SCMIE=0 
        BCLR    CRGINT,$12
        ; VREGCTRL: LVIE=0 
        BCLR    VREGCTRL,$02
        ; COPCTL: WCOP=0,RSBCK=0,CR2=0,CR1=0,CR0=0 
        CLR     COPCTL                                               
        ; RDRIV: RDPE=0,RDPB=0,RDPA=0 
        BCLR    RDRIV,$13
        ; RDRAD: RDRAD7=0,RDRAD6=0,RDRAD5=0,RDRAD4=0,RDRAD3=0,RDRAD2=0,RDRAD1=0,RDRAD0=0 
        CLR     RDRAD                                               
        ; RDRJ: RDRJ7=0,RDRJ6=0 
        BCLR    RDRJ,$C0
        ; RDRM: RDRM5=0,RDRM4=0,RDRM3=0,RDRM2=0,RDRM1=0,RDRM0=0 
        BCLR    RDRM,$3F
        ; RDRP: RDRP7=0,RDRP6=0,RDRP5=0,RDRP4=0,RDRP3=0,RDRP2=0,RDRP1=0,RDRP0=0 
        CLR     RDRP                                               
        ; RDRS: RDRS3=0,RDRS2=0,RDRS1=0,RDRS0=0 
        BCLR    RDRS,$0F
        ; RDRT: RDRT7=0,RDRT6=0,RDRT5=0,RDRT4=0,RDRT3=0,RDRT2=0,RDRT1=0,RDRT0=0 
        CLR     RDRT                                               
        ; INTCR: IRQEN=0 
        BCLR    INTCR,$40
  ; ### 
  ; Initial interrupt priority 
        CLI                            ; Enable interrupts 
        RTC

;** ===================================================================
;**     Interrupt handler : isr_default
;**
;**     Description :
;**         User interrupt service routine. 
;**     Parameters  : None
;**     Returns     : Nothing
;** ===================================================================
        XDEF    isr_default
isr_default:
  ; Write your interrupt code here ... 

        RTI
; end of isr_default 




_code_curPos:   EQU     *              ; remember original position of code for restoring at the end of the file

; Initialization of the CPU registers in FLASH 




; Interrupt vector table 

  ifndef UNASSIGNED_ISR
UNASSIGNED_ISR:    EQU     isr_default ; unassigned interrupt service routine
  endif
        ORG     $FF80                  ; Interrupt vector table
_vect:
                ; ISR name                 No. Address Pri Name          Description 
        DC.W    UNASSIGNED_ISR         ; 0x3F  0xFF80   1  ivVReserved63 unused by PE 
        DC.W    UNASSIGNED_ISR         ; 0x3E  0xFF82   1  ivVReserved62 unused by PE 
        DC.W    UNASSIGNED_ISR         ; 0x3D  0xFF84   1  ivVReserved61 unused by PE 
        DC.W    UNASSIGNED_ISR         ; 0x3C  0xFF86   1  ivVReserved60 unused by PE 
        DC.W    UNASSIGNED_ISR         ; 0x3B  0xFF88   1  ivVReserved59 unused by PE 
        DC.W    UNASSIGNED_ISR         ; 0x3A  0xFF8A   1  ivVvreglvi    unused by PE 
        DC.W    UNASSIGNED_ISR         ; 0x39  0xFF8C   1  ivVpwmesdn    unused by PE 
        DC.W    UNASSIGNED_ISR         ; 0x38  0xFF8E   1  ivVportp      unused by PE 
        DC.W    UNASSIGNED_ISR         ; 0x37  0xFF90   1  ivVReserved55 unused by PE 
        DC.W    UNASSIGNED_ISR         ; 0x36  0xFF92   1  ivVReserved54 unused by PE 
        DC.W    UNASSIGNED_ISR         ; 0x35  0xFF94   1  ivVReserved53 unused by PE 
        DC.W    UNASSIGNED_ISR         ; 0x34  0xFF96   1  ivVReserved52 unused by PE 
        DC.W    UNASSIGNED_ISR         ; 0x33  0xFF98   1  ivVReserved51 unused by PE 
        DC.W    UNASSIGNED_ISR         ; 0x32  0xFF9A   1  ivVReserved50 unused by PE 
        DC.W    UNASSIGNED_ISR         ; 0x31  0xFF9C   1  ivVReserved49 unused by PE 
        DC.W    UNASSIGNED_ISR         ; 0x30  0xFF9E   1  ivVReserved48 unused by PE 
        DC.W    UNASSIGNED_ISR         ; 0x2F  0xFFA0   1  ivVReserved47 unused by PE 
        DC.W    UNASSIGNED_ISR         ; 0x2E  0xFFA2   1  ivVReserved46 unused by PE 
        DC.W    UNASSIGNED_ISR         ; 0x2D  0xFFA4   1  ivVReserved45 unused by PE 
        DC.W    UNASSIGNED_ISR         ; 0x2C  0xFFA6   1  ivVReserved44 unused by PE 
        DC.W    UNASSIGNED_ISR         ; 0x2B  0xFFA8   1  ivVReserved43 unused by PE 
        DC.W    UNASSIGNED_ISR         ; 0x2A  0xFFAA   1  ivVReserved42 unused by PE 
        DC.W    UNASSIGNED_ISR         ; 0x29  0xFFAC   1  ivVReserved41 unused by PE 
        DC.W    UNASSIGNED_ISR         ; 0x28  0xFFAE   1  ivVReserved40 unused by PE 
        DC.W    UNASSIGNED_ISR         ; 0x27  0xFFB0   1  ivVcantx      unused by PE 
        DC.W    UNASSIGNED_ISR         ; 0x26  0xFFB2   1  ivVcanrx      unused by PE 
        DC.W    UNASSIGNED_ISR         ; 0x25  0xFFB4   1  ivVcanerr     unused by PE 
        DC.W    UNASSIGNED_ISR         ; 0x24  0xFFB6   1  ivVcanwkup    unused by PE 
        DC.W    UNASSIGNED_ISR         ; 0x23  0xFFB8   1  ivVflash      unused by PE 
        DC.W    UNASSIGNED_ISR         ; 0x22  0xFFBA   1  ivVReserved34 unused by PE 
        DC.W    UNASSIGNED_ISR         ; 0x21  0xFFBC   1  ivVReserved33 unused by PE 
        DC.W    UNASSIGNED_ISR         ; 0x20  0xFFBE   1  ivVReserved32 unused by PE 
        DC.W    UNASSIGNED_ISR         ; 0x1F  0xFFC0   1  ivVReserved31 unused by PE 
        DC.W    UNASSIGNED_ISR         ; 0x1E  0xFFC2   1  ivVReserved30 unused by PE 
        DC.W    UNASSIGNED_ISR         ; 0x1D  0xFFC4   1  ivVcrgscm     unused by PE 
        DC.W    UNASSIGNED_ISR         ; 0x1C  0xFFC6   1  ivVcrgplllck  unused by PE 
        DC.W    UNASSIGNED_ISR         ; 0x1B  0xFFC8   1  ivVReserved27 unused by PE 
        DC.W    UNASSIGNED_ISR         ; 0x1A  0xFFCA   1  ivVReserved26 unused by PE 
        DC.W    UNASSIGNED_ISR         ; 0x19  0xFFCC   1  ivVReserved25 unused by PE 
        DC.W    UNASSIGNED_ISR         ; 0x18  0xFFCE   1  ivVportj      unused by PE 
        DC.W    UNASSIGNED_ISR         ; 0x17  0xFFD0   1  ivVReserved23 unused by PE 
        DC.W    UNASSIGNED_ISR         ; 0x16  0xFFD2   1  ivVatd0       unused by PE 
        DC.W    UNASSIGNED_ISR         ; 0x15  0xFFD4   1  ivVReserved21 unused by PE 
        DC.W    UNASSIGNED_ISR         ; 0x14  0xFFD6   1  ivVsci        unused by PE 
        DC.W    UNASSIGNED_ISR         ; 0x13  0xFFD8   1  ivVspi        unused by PE 
        DC.W    UNASSIGNED_ISR         ; 0x12  0xFFDA   1  ivVtimpaie    unused by PE 
        DC.W    UNASSIGNED_ISR         ; 0x11  0xFFDC   1  ivVtimpaovf   unused by PE 
        DC.W    UNASSIGNED_ISR         ; 0x10  0xFFDE   1  ivVtimovf     unused by PE 
        DC.W    UNASSIGNED_ISR         ; 0x0F  0xFFE0   1  ivVtimch7     unused by PE 
        DC.W    UNASSIGNED_ISR         ; 0x0E  0xFFE2   1  ivVtimch6     unused by PE 
        DC.W    UNASSIGNED_ISR         ; 0x0D  0xFFE4   1  ivVtimch5     unused by PE 
        DC.W    UNASSIGNED_ISR         ; 0x0C  0xFFE6   1  ivVtimch4     unused by PE 
        DC.W    UNASSIGNED_ISR         ; 0x0B  0xFFE8   1  ivVtimch3     unused by PE 
        DC.W    UNASSIGNED_ISR         ; 0x0A  0xFFEA   1  ivVtimch2     unused by PE 
        DC.W    UNASSIGNED_ISR         ; 0x09  0xFFEC   1  ivVtimch1     unused by PE 
        DC.W    UNASSIGNED_ISR         ; 0x08  0xFFEE   1  ivVtimch0     unused by PE 
        DC.W    UNASSIGNED_ISR         ; 0x07  0xFFF0   1  ivVrti        unused by PE 
        DC.W    UNASSIGNED_ISR         ; 0x06  0xFFF2   1  ivVirq        unused by PE 
        DC.W    UNASSIGNED_ISR         ; 0x05  0xFFF4   -  ivVxirq       unused by PE 
        DC.W    UNASSIGNED_ISR         ; 0x04  0xFFF6   -  ivVswi        unused by PE 
        DC.W    UNASSIGNED_ISR         ; 0x03  0xFFF8   -  ivVtrap       unused by PE 
                ; Reset handler name 
        DC.W    MCU_init_reset         ; 0x02  0xFFFA   -  ivVcop        unused by PE 
        DC.W    MCU_init_reset         ; 0x01  0xFFFC   -  ivVclkmon     unused by PE 
        DC.W    MCU_init_reset         ; 0x00  0xFFFE   -  ivVreset      used by PE 


        ORG     _code_curPos           ; restore original position for code

;** ###################################################################
;**
;**     This file was created by Processor Expert 3.02 [04.44]
;**     for the Freescale HCS12 series of microcontrollers.
;**
;** ###################################################################
